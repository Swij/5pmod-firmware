## boards/arm/5pmod_nrf52840/Kconfig.defconfig
```kconfig
# nRF52840 DK NRF52840 board configuration

# Copyright (c) 2016 Nordic Semiconductor ASA
# SPDX-License-Identifier: Apache-2.0

if BOARD_5PMOD_NRF52840

config BOARD
	default "5pmod_nrf52840"

if USB

config USB_NRFX
	default y

config USB_DEVICE_STACK
	default y

endif # USB

config BT_CTLR
	default BT

endif # BOARD_5PMOD_NRF52840
```

## west.yml
```yaml
manifest:
  remotes:
    - name: zephyrproject-rtos
      url-base: https://github.com/zephyrproject-rtos
    - name: 5pmod
      url-base: https://github.com/swij
  projects:
    - name: zephyr
      remote: zephyrproject-rtos
      revision: v2.7-branch
      import: true
    - name: 5pmod-boards
      remote: 5pmod
      revision: b3301800f930e58d73758b77a7efa96b5ea6faff
      path: modules/boards/5pmod-boards
```
